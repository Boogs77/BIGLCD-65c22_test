// LCD & USD control lines
//   ARD MEGA  | Port  | Display pcb |  Function - 8080 Parallel   |
//------------+-------+-------------+-----------------------------+
//  5V        |       |     vcc     |  POWER                      |
//  GND	      |       |     gnd     |  GROUND                     |
// -----------+-------+-------------+-----------------------------+
//  D8        | PD0   |     ~R/W    |  Data Read Write (/WR)(/RD) |
//  D9        | PD1   |     ~IRQ    |  Interrupt Request          |
//  D10       | PD2   |     ~RESET  |  Reset (\RST)               |
// -----------+-------+-------------+-----------------------------+
// Data Lines
// -----------+-------+-------------+-----------------------------+
//  D7        | PH4   |     D0      |  LCD_D10 (DB0)              |
//  D6        | PH3   |     D1      |  LCD_D11 (DB1)              |
//  D5        | PE3   |     D2      |  LCD_D12 (DB2)              |
//  D4        | PG5   |     D3      |  LCD_D13 (DB3)              |
//  D3        | PE5   |     D4      |  LCD_D14 (DB4)              |
//  D2        | PE4   |     D5      |  LCD_D15 (DB5)              |
//  D1        | PE1   |     D6      |  LCD_D16 (DB6)              |
//  D0        | PE0   |     D7      |  LCD_D17 (DB7)              |
// -----------+-------+-------------+-----------------------------+
// Address Lines
// -----------+-------+-------------+-----------------------------+
//  A0        | PF0   |     A0      |  LCD_D10 (DB0)              |
//  A1        | PF1   |     A1      |  LCD_D11 (DB1)              |
//  A2        | PF2   |     A2      |  LCD_D12 (DB2)              |
//  A3        | PF3   |     A3      |  LCD_D13 (DB3)              |
//  A4        | PF4   |     A4      |  LCD_D14 (DB4)              |
//  A5        | PF5   |     A5      |  LCD_D15 (DB5)              |
//  A6        | PF6   |     A6      |  LCD_D16 (DB6)              |
//  A7        | PF7   |     A7      |  LCD_D17 (DB7)              |
//  A8        | PK0   |     A8      |  LCD_D10 (DB0)              |
//  A9        | PK1   |     A9      |  LCD_D11 (DB1)              |
//  A10       | PK2   |     A10     |  LCD_D12 (DB2)              |
//  A11       | PK3   |     A11     |  LCD_D13 (DB3)              |
//  A12       | PK4   |     A12     |  LCD_D14 (DB4)              |
//  A13       | PK5   |     A13     |  LCD_D15 (DB5)              |
//  A14       | PK6   |     A14     |  LCD_D16 (DB6)              |
//  A15       | PK7   |     A15     |  LCD_D17 (DB7)              |
// -----------+-------+-------------+-----------------------------+

#define PORT_MANIPULATION

#define HRES 160
#define VRES 128

#define VIA_ADD    0xd1
#define VIA_PORTB  0x90
#define VIA_PORTA  0x91
#define VIA_ADDRB  0x92
#define VIA_ADDRA  0x93

#define RESET 19
#define IRQ 20
#define RW 21

//PA Structure ALL ACTIVE LOW; HALT and RESET not uset

#define RD 0x01 // B00000001 PA0 ~RD
#define WR 0x02 // B00000010 PA1 ~WR
#define CE 0x04 // B00000100 PA2 ~CE
#define CD 0x08 // B00001000 PA3 C~D
#define RS 0x20 // B00100000 PA5 ~RST

const uint8_t logo[2560] PROGMEM = {
   0x00,0x01,0xE0,0x07,0x80,0x00,0x00,0x00,0x00,0x00,0x00,0x00,0x00,0x00,0x00,0x00,0x00,0x00,0x00,0x00,
   0x00,0x03,0xF0,0x0F,0xC0,0x00,0x00,0x00,0x00,0x00,0x00,0x00,0x00,0x00,0x00,0x00,0x00,0x00,0x00,0x00,
   0x00,0x07,0x38,0x1C,0xE0,0x00,0x00,0x00,0x00,0x00,0x00,0x00,0x00,0x00,0x00,0x00,0x00,0x00,0x00,0x00,
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   0x00,0x00,0x00,0x00,0x00,0x00,0x00,0x00,0x00,0x00,0x00,0x00,0x00,0x00,0x00,0x00,0x00,0x00,0x00,0x00};

void writedatalines(unsigned int data){

  PORTG = ((data & 0x08) << 2);                   
  PORTH = ((data & 0x01) << 4) + ((data & 0x02) << 2);
  PORTE = ((data & 0x04) << 1) + ((data & 0x10) << 1) + ((data & 0x20) >> 1) + ((data & 0x40 ) >> 5) + ((data & 0x80) >> 7);
}

unsigned int LCD_BITS = 0;

void writedata2reg(unsigned int data, unsigned int VIA_ADDdd, unsigned int LOWregadd){
  writedatalines(data);
  PORTK = VIA_ADDdd;
  PORTF = LOWregadd;  //PORTA
  digitalWrite(RW, LOW);
  delayMicroseconds(10);
  digitalWrite(RW, HIGH);
}

void CLR_CS(){
  LCD_BITS &= ~(CE);
  writedata2reg(LCD_BITS,VIA_ADD,VIA_PORTA);
  //delayMicroseconds(100);
}

void SET_CS(){
  LCD_BITS |= (CE);
  writedata2reg(LCD_BITS,VIA_ADD,VIA_PORTA);
  //delayMicroseconds(100);
}

void CLR_DC(){
  LCD_BITS &= ~(CD);
  writedata2reg(LCD_BITS,VIA_ADD,VIA_PORTA);
}

void SET_DC(){
  LCD_BITS |= (CD);
  writedata2reg(LCD_BITS,VIA_ADD,VIA_PORTA);
}

void CLR_WR(){
  LCD_BITS &= ~(WR);
  writedata2reg(LCD_BITS,VIA_ADD,VIA_PORTA);
}

void SET_WR(){
  LCD_BITS |= (WR);
  writedata2reg(LCD_BITS,VIA_ADD,VIA_PORTA);
}

void CLR_RD(){
  LCD_BITS &= ~(RD);
  writedata2reg(LCD_BITS,VIA_ADD,VIA_PORTA);
}

void SET_RD(){
  LCD_BITS |= (RD);
  writedata2reg(LCD_BITS,VIA_ADD,VIA_PORTA);
}

void CLR_RS(){
  LCD_BITS &= ~(RS);
  writedata2reg(LCD_BITS,VIA_ADD,VIA_PORTA);
}

void SET_RS(){
  LCD_BITS |= (RS);
  writedata2reg(LCD_BITS,VIA_ADD,VIA_PORTA);
}

void reset() {
  //digitalWrite(RESET, HIGH);  //done in setting_6522()
  delayMicroseconds(20);
  SET_RS();
  delayMicroseconds(100);
  CLR_RS();
  delayMicroseconds(10);  
  SET_RS();
  //digitalWrite(RESET, HIGH);
  //delayMicroseconds(20);  
}

void setting_arduino(){
  
  DDRK = 0xFF;
  DDRF = 0xFF;
  DDRH = B00011000;
  DDRE = B00111011;
  DDRG = B00100000;

}

void setting_6522(){
   
  pinMode (RW, OUTPUT);
  pinMode (IRQ, INPUT);
  pinMode (RESET, OUTPUT);
  
  digitalWrite(RESET, HIGH);
  digitalWrite(RW, HIGH);
  
  reset();
  
  writedata2reg(0xFF,VIA_ADD,VIA_ADDRB); //lda @%11111111 //sta DDRB_2
  writedata2reg(0xFF,VIA_ADD,VIA_ADDRA); //lda @%00111111 //sta DDRA_2

}

void write_command(uint8_t command)
{ 
  SET_DC();      // select the LCD's command register
  CLR_CS();      // select the LCD controller
  writedata2reg(command,VIA_ADD,VIA_PORTB);
  //writedatalines(command); //PORTD = command;// send the data via parallel
  CLR_WR();      // clear the write register

  SET_WR();      // set the write register

  SET_CS();      // deselct the LCD controlleR
}

void write_data(uint8_t data)
{
  
  CLR_DC();      // select the LCD's data register
  CLR_CS();      // select the LCD controller

  writedata2reg(data,VIA_ADD,VIA_PORTB);
  //writedatalines(data);//PORTD = data;// send the data via parallel
  CLR_WR();      // clear the write register

  SET_WR();      // set the write register

  SET_CS();      // deselct the LCD controller

}

void cleardisplay()
{
  int i = HRES * VRES / 8;

  write_data(0x00);
  write_data(0x08);
  write_command(0x24);

  write_command(0xB0); // auto write

  while (i--)
  {
    write_data(0x00);
  }

  write_command(0xB2); // auto write reset
}

void cleartext()
{
  write_data(0x00);
  write_data(0x00);
  write_command(0x24);

  write_command(0xB0); // auto write

  for (int row = 0; row < VRES; row++)
  {
    for (int col = 0; col < HRES / 8; col++)
    {
      write_data(0x00);
    }
  //    Serial.println(row);    
  }
  write_command(0xB2); // auto write reset
}

void display_bitmap(const uint8_t *display)
{

  write_data(0x00);
  write_data(0x08);
  write_command(0x24);

  write_command(0x98); // display mode - graphic on, text off
  write_command(0xB0); // auto write
  int x = 0;

  for (int row = 0; row < VRES; row++)
  {
    for (int col = 0; col < HRES / 8; col++)
    {
      write_data(pgm_read_byte(&display[x]));
      x++;
      delay(0);
    }
  }
  write_command(0xB2); // auto write reset
}

void initialize_display()
{
  write_data(0x00);
  write_data(0x00);
  write_command(0x40); // set text home address

  write_data(0x14); // 240/8
  write_data(0x00);
  write_command(0x41); // set text area

  write_data(0x00);
  write_data(0x08);    // address 0x0800
  write_command(0x42); // set graphic home address

  write_data(HRES / 8);
  write_data(0x00);
  write_command(0x43); // set graphic area

  write_command(0xA0); // 1 line cursor
  write_command(0x81); // mode set - exor mode
  write_command(0x94); // 9c display mode - graphic on, text on 94

  write_data(0x00);
  write_data(0x00);
  write_command(0x21); // set cursor position
}

void writeString(String str) {
  for(int i = 0; i < str.length(); i++){
    write_data(str.charAt(i)-0x20);
    delayMicroseconds(10);
  }
}

int x_coord = 0;
int y_coord = 0;

signed char xinc = 1;
signed char yinc = 1;

int hi_pointer = 0;
int lo_pointer = 0;
word position_xy = 0;

String str = "Hello, World!";
String clr = "             ";
unsigned char len = str.length();


void setup() {
  Serial.begin(9600);


  setting_arduino();
  setting_6522();
  
  SET_RD();
  SET_WR();
  SET_CS();
  //SET_RS(); //Already HIGH in reset()
  delay(1);


  //delayMicroseconds(10);
  //Serial.println("Init Display...");
  // reset();
  initialize_display();  
  // //Serial.println("Clear Text...");
  cleartext();
  cleardisplay();
  // //Serial.println("Setup done!");

}

void loop() {
/*
  CLR_DC();
  SET_RD();
  delay(500);
  CLR_RD();
  SET_WR();
  delay(500);
  CLR_WR();
  SET_CS();
  delay(500);
  CLR_CS();
  SET_DC();
  delay(500);
*/
   // display_bitmap(logo);
 write_data(lo_pointer);
 write_data(hi_pointer);
 write_command(0x24);

write_command(0xB0); // auto write
writeString(str);
// write_data('A' - 0x20); // scrivi carattere 'A' (codifica T6963C)
// write_command(0xC0);    // data write and increment
// //   // delay(1);
// //   // Serial.println(i);}
   while (1);   


}
